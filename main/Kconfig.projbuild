## main/Kconfig.projbuild
```kconfig
menu "nesigner Configuration"

    choice SIGNER_TRANSPORT_BACKEND
        prompt "Communication Transport Backend"
        default SIGNER_TRANSPORT_TINYUSB if SOC_USB_OTG_SUPPORTED
        default SIGNER_TRANSPORT_USB_SERIAL_JTAG if SOC_USB_SERIAL_JTAG_SUPPORTED
        default SIGNER_TRANSPORT_UART
        help
            Select the primary communication transport backend for nesigner.

        config SIGNER_TRANSPORT_TINYUSB
            bool "USB-OTG TinyUSB CDC-ACM (ESP32-S3, ESP32-P4)"
            depends on SOC_USB_OTG_SUPPORTED
            select TINYUSB_CDC_ENABLED
            help
                Uses TinyUSB stack with custom VID:PID (0x2323:0x3434).

        config SIGNER_TRANSPORT_USB_SERIAL_JTAG
            bool "Built-in USB Serial/JTAG (ESP32-C5, ESP32-C3, ESP32-C6)"
            depends on SOC_USB_SERIAL_JTAG_SUPPORTED
            help
                Uses the native hardware USB Serial/JTAG controller with Espressif VID:PID (0x303a:0x1001).

        config SIGNER_TRANSPORT_UART
            bool "Standard UART"
            help
                Uses standard hardware UART for frame communication.

    endchoice

    menu "UART Configuration"
        config SIGNER_UART_PORT_NUM
            int "UART Port Number"
            default 1 if IDF_TARGET_ESP32C5 || IDF_TARGET_ESP32C3 || IDF_TARGET_ESP32C6
            default 2 if IDF_TARGET_ESP32S3 || IDF_TARGET_ESP32P4
            default 0
            help
                UART port number to use.

        config SIGNER_UART_TX_PIN
            int "UART TX GPIO Pin"
            default 4 if IDF_TARGET_ESP32S3 || IDF_TARGET_ESP32C3
            default 11 if IDF_TARGET_ESP32C5
            default 14 if IDF_TARGET_ESP32P4
            default 1
            help
                GPIO pin for UART TX.

        config SIGNER_UART_RX_PIN
            int "UART RX GPIO Pin"
            default 5 if IDF_TARGET_ESP32S3 || IDF_TARGET_ESP32C3
            default 12 if IDF_TARGET_ESP32C5
            default 15 if IDF_TARGET_ESP32P4
            default 2
            help
                GPIO pin for UART RX.

        config SIGNER_UART_BAUD_RATE
            int "UART Baud Rate"
            default 115200
            help
                UART communication baud rate.
    endmenu

endmenu
```

## sdkconfig.defaults.esp32s2
```kconfig
# ESP32-S2 Target Configuration
CONFIG_IDF_TARGET="esp32s2"

# Transport selection: TinyUSB CDC-ACM (USB-OTG)
CONFIG_SIGNER_TRANSPORT_TINYUSB=y

# TinyUSB configuration
CONFIG_TINYUSB_RHPORT_FS=y
CONFIG_TINYUSB_MODE_DMA=y
CONFIG_TINYUSB_TASK_PRIORITY=5
CONFIG_TINYUSB_TASK_STACK_SIZE=4096
CONFIG_TINYUSB_TASK_AFFINITY_CPU0=y
CONFIG_TINYUSB_CDC_ENABLED=y
CONFIG_TINYUSB_CDC_COUNT=1
CONFIG_TINYUSB_CDC_RX_BUFSIZE=512
CONFIG_TINYUSB_CDC_TX_BUFSIZE=512

# UART fallback configuration (S2 has UART0 and UART1)
CONFIG_SIGNER_UART_PORT_NUM=1
CONFIG_SIGNER_UART_TX_PIN=17
CONFIG_SIGNER_UART_RX_PIN=18
```

## sdkconfig.defaults.esp32s3
```kconfig
# ESP32-S3 Target Configuration
CONFIG_IDF_TARGET="esp32s3"

# Transport selection
CONFIG_SIGNER_TRANSPORT_TINYUSB=y

# TinyUSB configuration
CONFIG_TINYUSB_RHPORT_FS=y
CONFIG_TINYUSB_MODE_DMA=y
CONFIG_TINYUSB_TASK_PRIORITY=5
CONFIG_TINYUSB_TASK_STACK_SIZE=4096
CONFIG_TINYUSB_TASK_AFFINITY_CPU1=y
CONFIG_TINYUSB_CDC_ENABLED=y
CONFIG_TINYUSB_CDC_COUNT=1
CONFIG_TINYUSB_CDC_RX_BUFSIZE=512
CONFIG_TINYUSB_CDC_TX_BUFSIZE=512

# UART fallback configuration
CONFIG_SIGNER_UART_PORT_NUM=2
CONFIG_SIGNER_UART_TX_PIN=4
CONFIG_SIGNER_UART_RX_PIN=5
```
